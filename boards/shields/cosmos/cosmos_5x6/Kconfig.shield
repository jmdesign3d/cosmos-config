## boards/shields/cosmos/cosmos_5x6/Kconfig.shield
```kconfig
config SHIELD_COSMOS_5x6_LEFT
    def_bool $(shields_list_contains,cosmos_5x6_left)

config SHIELD_COSMOS_5x6_RIGHT
    def_bool $(shields_list_contains,cosmos_5x6_right)
```

## config/boards/shields/cosmos/Kconfig.defconfig
```kconfig
if SHIELD_COSMOS_LEFT

CONFIG_ZMK_KEYBOARD_NAME
    default "COSMOS"

CONFIG_ZMK_SPLIT_ROLE_CENTRAL
    default y

endif

if SHIELD_COSMOS_LEFT || SHIELD_COSMOS_RIGHT

CONFIG_ZMK_SPLIT
    default y

if ZMK_DISPLAY

CONFIG_I2C
    default y

CONFIG_SSD1306
    default y

endif # ZMK_DISPLAY

if LVGL

CONFIG_LV_Z_VDB_SIZE
    default 64

CONFIG_LV_DPI_DEF
    default 148

CONFIG_LV_Z_BITS_PER_PIXEL
    default 1

choice LV_COLOR_DEPTH
    default LV_COLOR_DEPTH_1
endchoice

endif # LVGL

endif
```

## config/west.yml
```yaml
manifest:
  defaults:
    revision: v0.3
  remotes:
    - name: zmkfirmware
      url-base: https://github.com/zmkfirmware
    # Additional modules containing boards/shields/custom code can be listed here as well
    # See https://docs.zephyrproject.org/3.2.0/develop/west/manifest.html#projects
    - name: jmdesign3d
      url-base: https://github.com/jmdesign3d
  projects:
    - name: zmk
      remote: zmkfirmware
      import: app/west.yml
    - name: cosmos-config
      remote: jmdesign3d
      revision: main
  self:
    path: config
```
